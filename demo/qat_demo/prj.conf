## prj.conf
```kconfig
#
# qat_demo setting
#
CONFIG_QCCSDK_DEMO=y
CONFIG_QCCSDK_CONSOLE=y
CONFIG_FLASH_SHELL=y
CONFIG_FREERTOS_PLUS_POSIX=y

CONFIG_WIFI_SHELL=y
CONFIG_WLAN_QAPI=y
CONFIG_PLATFORM_SHELL=y
CONFIG_LOWPOWER_SHELL=y
CONFIG_UNITTEST_SHELL=y
CONFIG_I2CM_SHELL=y
CONFIG_GPIO_SHELL=y
CONFIG_NET_SHELL=y
CONFIG_UART_SHELL=y
CONFIG_LWIP_HEAP_POOL=y
CONFIG_6GHZ=y
CONFIG_6G_BAND=y
CONFIG_RTT_VIEW_CLI=y

CONFIG_WATCH_DOG_ENABLE=n
CONFIG_WATCH_DOG_BITE_TIME=8
CONFIG_FW_UPGRADE=y
CONFIG_FILE_SYSTEM=y
CONFIG_FILE_SYSTEM_LITTLEFS=y
CONFIG_POSIX_FS_API=y
CONFIG_FS_SHELL=y
CONFIG_MPU_DEMO=y
CONFIG_MQTT_CLIENT=y
CONFIG_MQTT_CLIENT_DEMO=y
#CONFIG_SIGMA_TRAFFIC=n
CONFIG_RING_IF_ONLY=n
CONFIG_QCSPI_HFC_TEST=n
CONFIG_QCSPI_HFC_ATCMD_ENABLE=n
CONFIG_HTTP_CLIENT=y
CONFIG_HTTP_CLIENT_DEMO=y
CONFIG_HTTP_SERVER=y
CONFIG_QAT_HTTP_SERVER_DEMO=y
CONFIG_RNG_TEST=y
CONFIG_SNTP_CLIENT=y
CONFIG_SNTP_CLIENT_DEMO=y
CONFIG_WIFI_FW_COREDUMP_SUPPORT=y
CONFIG_WIFI_FW_RAMDUMP_PRINT_FLAG=0

CONFIG_QAT=y
CONFIG_QAT_COMMON_DEMO=y
CONFIG_QAT_TRANSMISSION_MODULE=0
CONFIG_QAT_TCPIP_DEMO=y
CONFIG_QAT_MQTT_DEMO=y
CONFIG_QAT_WLAN_DEMO=y
CONFIG_QAT_HTTPC_DEMO=y
CONFIG_QAT_OTA_DEMO=y
CONFIG_QAT_FSTORE_DEMO=y
CONFIG_QAT_CB_SIZE_MTU_MULTIPLIER=10
CONFIG_QAT_CB_QUEUE_MAX_LENGTH=10
CONFIG_WPS=y
CONFIG_WPS_LIB=y
# end of qat_demo setting
```

## src/qat_demo.h
```c
#ifndef QAT_DEMO_H
#define QAT_DEMO_H
/*
#Copyright (c) 2024 Qualcomm Innovation Center, Inc. All rights reserved.
#SPDX-License-Identifier: BSD-3-Clause-Clear
 */
/**
 * Initialize this mgmt filter demo:
 * - start the mgmt_frame_recv_thread
 */
void Initialize_QAT_Common_Demo(void);

void Initialize_QAT_Mqtt_Demo(void);

void Initialize_QAT_TCPIP_Demo(void);

void Initialize_QAT_Wlan_Demo(void);

void Initialize_QAT_Http_Server_Demo(void);

void Initialize_QAT_HttpC_Demo(void);

void Initialize_QAT_OTA_Demo(void);

#ifdef CONFIG_QAT_FSTORE_DEMO
void Initialize_QAT_Fstore_Demo(void);
#endif

#ifdef CONFIG_QAT_POWERSAVE_DEMO
void Initialize_QAT_POWERSAVE_Demo(void);
#endif

#endif /* QAT_DEMO_H */
```

## src/qat_demo_main.c
```c
/*
 * Copyright (c) 2024 Qualcomm Innovation Center, Inc. All rights reserved.
 * SPDX-License-Identifier: BSD-3-Clause-Clear
 */

#include <string.h>
#include <stdint.h>
#include "qat_demo.h"
#ifdef FERMION_SILICON
extern uint32_t UART_Send_direct(char *txbuf, uint32_t buflen);
#define UART_SEND_DIRECT(str) UART_Send_direct((str), strlen(str))
#else
#define UART_SEND_DIRECT(str)
#endif

static volatile int dead_loop = 0;

void app_init(void)
{
    UART_SEND_DIRECT("app_init entry\r\n");
    // register app console commands here if have
#ifdef CONFIG_QAT_COMMON_DEMO
    Initialize_QAT_Common_Demo();
#endif

#ifdef CONFIG_QAT_TCPIP_DEMO
    Initialize_QAT_TCPIP_Demo();
#endif

#ifdef CONFIG_QAT_MQTT_DEMO
    Initialize_QAT_Mqtt_Demo();
#endif

#ifdef CONFIG_QAT_HTTP_SERVER_DEMO
    Initialize_QAT_Http_Server_Demo();
#endif

#ifdef CONFIG_QAT_WLAN_DEMO
    Initialize_QAT_Wlan_Demo();
#endif

#ifdef CONFIG_QAT_HTTPC_DEMO
    Initialize_QAT_HttpC_Demo();
#endif

#ifdef CONFIG_QAT_OTA_DEMO
    Initialize_QAT_OTA_Demo();

#ifdef CONFIG_FWUP_DEMO
    Initialize_FwUpgrade_Demo();
#endif

#endif

#ifdef CONFIG_QAT_FSTORE_DEMO
    Initialize_QAT_Fstore_Demo();
#endif

    UART_SEND_DIRECT("app_init over\r\n");
}

void app_main(void)
{
    UART_SEND_DIRECT("app_main entry\r\n");
    UART_SEND_DIRECT("qcli demo!\r\n");
    if (dead_loop) {
        UART_SEND_DIRECT("Dead loop...\r\n");
        while (dead_loop)
            ;
    }
    UART_SEND_DIRECT("app_main over\r\n");
}
```

## src/qat_fstore_demo.c
```c
/*
 * Copyright (c) Qualcomm Technologies, Inc. and/or its subsidiaries.
 *
 * SPDX-License-Identifier: BSD-3-Clause-Clear
 */

/*-------------------------------------------------------------------------
 * Include Files
 *-----------------------------------------------------------------------*/
#include <stdio.h>
#include <string.h>
#include <stdbool.h>
#include "fs.h"
#include "qat.h"
#include "qat_api.h"

/*-------------------------------------------------------------------------
 * Preprocessor Definitions and Constants
 *-----------------------------------------------------------------------*/
#define FSTORE_MOUNT_POINT     "/lfs"
#define FSTORE_MAX_PATH        130
#define FSTORE_READ_CHUNK_SIZE 512
#define FSTORE_CHUNK_HEX_MAX   128  /* max bytes per hex chunk = 256 hex chars */

/*-------------------------------------------------------------------------
 * Type Declarations
 *-----------------------------------------------------------------------*/
static struct {
    struct fs_file_t file;
    size_t           total_len;
    size_t           received_len;
    bool             active;
} writefile_state;

/*-------------------------------------------------------------------------
 * Function Declarations
 *-----------------------------------------------------------------------*/
static QAT_Command_Status_t Extend_Command_WriteFile(uint32_t Op_Type, uint32_t Parameter_Count,
                                                     QAT_Parameter_t *Parameter_List);
static QAT_Command_Status_t Extend_Command_ReadFile(uint32_t Op_Type, uint32_t Parameter_Count,
                                                    QAT_Parameter_t *Parameter_List);
static QAT_Command_Status_t Extend_Command_DelFile(uint32_t Op_Type, uint32_t Parameter_Count,
                                                   QAT_Parameter_t *Parameter_List);

/*-------------------------------------------------------------------------
 * Command Table
 *-----------------------------------------------------------------------*/
static QAT_Command_t QAT_Fstore_Command_List[] = {
    {"+WRITEFILE", Extend_Command_WriteFile, QAT_OP_EXEC_W_PARAM | QAT_OP_EXEC},
    {"+READFILE",  Extend_Command_ReadFile,  QAT_OP_EXEC_W_PARAM | QAT_OP_EXEC},
    {"+DELFILE",   Extend_Command_DelFile,   QAT_OP_EXEC_W_PARAM | QAT_OP_EXEC},
};

/*-------------------------------------------------------------------------
 * Helper: normalize path to /lfs/<path>
 * Returns 0 on success, -1 if the result would exceed out_sz.
 *-----------------------------------------------------------------------*/
static int normalize_path(const char *input, char *out, size_t out_sz)
{
    bool has_prefix = strncmp(input, FSTORE_MOUNT_POINT, strlen(FSTORE_MOUNT_POINT)) == 0;

    if (has_prefix) {
        if (strlen(input) + 1 > out_sz) {
            return -1;
        }
        snprintf(out, out_sz, "%s", input);
    } else if (input[0] == '/') {
        /* Input starts with '/' but not the mount point: concatenate directly
         * to avoid double slash (e.g. /lfs + /foo/bar → /lfs/foo/bar). */
        if (strlen(FSTORE_MOUNT_POINT) + strlen(input) + 1 > out_sz) {
            return -1;
        }
        snprintf(out, out_sz, "%s%s", FSTORE_MOUNT_POINT, input);
    } else {
        /* Relative path: insert separator. */
        if (strlen(FSTORE_MOUNT_POINT) + 1 + strlen(input) + 1 > out_sz) {
            return -1;
        }
        snprintf(out, out_sz, "%s/%s", FSTORE_MOUNT_POINT, input);
    }
    return 0;
}

/*-------------------------------------------------------------------------
 * Helper: create all intermediate directories (mkdir -p semantics)
 *-----------------------------------------------------------------------*/
static void mkdir_parent(const char *path)
{
    char dir[FSTORE_MAX_PATH];
    /* Start scanning after the mount point prefix */
    const char *p = path + strlen(FSTORE_MOUNT_POINT);

    while (*p == '/') {
        p++;
    }

    while (*p) {
        const char *slash = strchr(p, '/');
        if (!slash) {
            break;  /* last component is the filename, stop */
        }
        size_t dir_len = (size_t)(slash - path);
        if (dir_len == 0 || dir_len >= sizeof(dir)) {
            break;
        }
        snprintf(dir, sizeof(dir), "%.*s", (int)dir_len, path);
        vfs_mkdir(dir);  /* ignore error — EEXIST is fine */
        p = slash + 1;
    }
}

/*-------------------------------------------------------------------------
 * Helper: decode one hex nibble; returns -1 on invalid character
 *-----------------------------------------------------------------------*/
static int hex_val(char c)
{
    if (c >= '0' && c <= '9') return c - '0';
    if (c >= 'a' && c <= 'f') return c - 'a' + 10;
    if (c >= 'A' && c <= 'F') return c - 'A' + 10;
    return -1;
}

/*-------------------------------------------------------------------------
 * AT+WRITEFILE=<path>,C,<size>   — create/truncate
 * AT+WRITEFILE=<path>,A,<hex>    — append hex-encoded chunk
 *-----------------------------------------------------------------------*/
static QAT_Command_Status_t Extend_Command_WriteFile(uint32_t Op_Type, uint32_t Parameter_Count,
                                                     QAT_Parameter_t *Parameter_List)
{
    char response[64];

    switch (Op_Type) {
        case QAT_OP_EXEC_W_PARAM: {
            if (Parameter_Count < 2 || !Parameter_List[0].String_Value ||
                !Parameter_List[1].String_Value) {
                QAT_Response_Str(QAT_RC_ERROR,
                    "+WRITEFILE: usage AT+WRITEFILE=<path>,C,<size> or AT+WRITEFILE=<path>,A,<hex>");
                return QAT_STATUS_SUCCESS_E;
            }

            if (!is_fs_mounted()) {
                QAT_Response_Str(QAT_RC_ERROR, "+WRITEFILE: filesystem not mounted");
                return QAT_STATUS_SUCCESS_E;
            }

            char path[FSTORE_MAX_PATH];
            if (normalize_path(Parameter_List[0].String_Value, path, sizeof(path)) < 0) {
                QAT_Response_Str(QAT_RC_ERROR, "+WRITEFILE: path too long");
                return QAT_STATUS_SUCCESS_E;
            }

            char mode = Parameter_List[1].String_Value[0];

            /* ---- C: create / truncate ---- */
            if (mode == 'C' || mode == 'c') {
                size_t expected = (Parameter_Count >= 3 && Parameter_List[2].Integer_Is_Valid)
                                  ? (size_t)Parameter_List[2].Integer_Value : 0;

                if (writefile_state.active) {
                    vfs_close(&writefile_state.file);
                    writefile_state.active = false;
                }
                mkdir_parent(path);
                fs_file_t_init(&writefile_state.file);
                int ret = vfs_open(&writefile_state.file, path, FS_O_CREATE | FS_O_WRITE);
                if (ret < 0) {
                    snprintf(response, sizeof(response), "+WRITEFILE: open failed (%d)", ret);
                    QAT_Response_Str(QAT_RC_ERROR, response);
                    return QAT_STATUS_SUCCESS_E;
                }
                vfs_truncate(&writefile_state.file, 0);
                writefile_state.total_len    = expected;
                writefile_state.received_len = 0;
                writefile_state.active       = true;
                QAT_Response_Str(QAT_RC_OK, NULL);

            /* ---- A: append hex-encoded chunk ---- */
            } else if (mode == 'A' || mode == 'a') {
                if (!writefile_state.active) {
                    QAT_Response_Str(QAT_RC_ERROR,
                        "+WRITEFILE: no file open, send C command first");
                    return QAT_STATUS_SUCCESS_E;
                }
                if (Parameter_Count < 3 || !Parameter_List[2].String_Value) {
                    QAT_Response_Str(QAT_RC_ERROR, "+WRITEFILE: hex data missing");
                    return QAT_STATUS_SUCCESS_E;
                }

                const char *hex = Parameter_List[2].String_Value;
                size_t hex_len = strlen(hex);

                if (hex_len == 0 || hex_len % 2 != 0) {
                    QAT_Response_Str(QAT_RC_ERROR,
                        "+WRITEFILE: hex data missing or odd length");
                    return QAT_STATUS_SUCCESS_E;
                }
                if (hex_len > FSTORE_CHUNK_HEX_MAX * 2) {
                    QAT_Response_Str(QAT_RC_ERROR, "+WRITEFILE: hex chunk too large");
                    return QAT_STATUS_SUCCESS_E;
                }

                uint8_t decode[FSTORE_CHUNK_HEX_MAX];
                size_t byte_count = hex_len / 2;

                for (size_t i = 0; i < byte_count; i++) {
                    int hi = hex_val(hex[i * 2]);
                    int lo = hex_val(hex[i * 2 + 1]);
                    if (hi < 0 || lo < 0) {
                        QAT_Response_Str(QAT_RC_ERROR, "+WRITEFILE: invalid hex character");
                        return QAT_STATUS_SUCCESS_E;
                    }
                    decode[i] = (uint8_t)((hi << 4) | lo);
                }

                if (writefile_state.total_len > 0 &&
                    writefile_state.received_len + byte_count > writefile_state.total_len) {
                    QAT_Response_Str(QAT_RC_ERROR, "+WRITEFILE: data exceeds declared length");
                    return QAT_STATUS_SUCCESS_E;
                }

                int32_t written = vfs_write(&writefile_state.file, decode, byte_count);
                if (written < 0) {
                    vfs_close(&writefile_state.file);
                    writefile_state.active = false;
                    snprintf(response, sizeof(response), "+WRITEFILE: write error (%d)",
                             (int)written);
                    QAT_Response_Str(QAT_RC_ERROR, response);
                    return QAT_STATUS_SUCCESS_E;
                }
                writefile_state.received_len += (size_t)written;

                if (writefile_state.total_len > 0 &&
                    writefile_state.received_len >= writefile_state.total_len) {
                    int close_ret = vfs_close(&writefile_state.file);
                    writefile_state.active = false;
                    if (close_ret < 0) {
                        snprintf(response, sizeof(response),
                                 "+WRITEFILE: close failed (%d)", close_ret);
                        QAT_Response_Str(QAT_RC_ERROR, response);
                    } else {
                        snprintf(response, sizeof(response), "+WRITEFILE: %u bytes written",
                                 (unsigned)writefile_state.received_len);
                        QAT_Response_Str(QAT_RC_OK, response);
                    }
                } else {
                    QAT_Response_Str(QAT_RC_OK, NULL);
                }

            } else {
                QAT_Response_Str(QAT_RC_ERROR, "+WRITEFILE: unknown mode, use C or A");
            }
            break;
        }

        default:
            if (writefile_state.active) {
                vfs_close(&writefile_state.file);
                writefile_state.active = false;
                QAT_Response_Str(QAT_RC_OK, "+WRITEFILE: transfer aborted");
            } else {
                QAT_Response_Str(QAT_RC_OK,
                    "+WRITEFILE=<path>,C,<size>  or  +WRITEFILE=<path>,A,<hex>");
            }
            break;
    }

    return QAT_STATUS_SUCCESS_E;
}

/*-------------------------------------------------------------------------
 * AT+READFILE=<path>
 *-----------------------------------------------------------------------*/
static QAT_Command_Status_t Extend_Command_ReadFile(uint32_t Op_Type, uint32_t Parameter_Count,
                                                    QAT_Parameter_t *Parameter_List)
{
    char response[64];

    if (Op_Type != QAT_OP_EXEC_W_PARAM) {
        QAT_Response_Str(QAT_RC_OK, "+READFILE=<path>");
        return QAT_STATUS_SUCCESS_E;
    }

    if (Parameter_Count < 1 || !Parameter_List[0].String_Value) {
        QAT_Response_Str(QAT_RC_ERROR, "+READFILE: usage AT+READFILE=<path>");
        return QAT_STATUS_SUCCESS_E;
    }

    if (!is_fs_mounted()) {
        QAT_Response_Str(QAT_RC_ERROR, "+READFILE: filesystem not mounted");
        return QAT_STATUS_SUCCESS_E;
    }

    char path[FSTORE_MAX_PATH];
    if (normalize_path(Parameter_List[0].String_Value, path, sizeof(path)) < 0) {
        QAT_Response_Str(QAT_RC_ERROR, "+READFILE: path too long");
        return QAT_STATUS_SUCCESS_E;
    }

    struct fs_dirent entry;
    if (vfs_stat(path, &entry) < 0) {
        QAT_Response_Str(QAT_RC_ERROR, "+READFILE: file not found");
        return QAT_STATUS_SUCCESS_E;
    }

    struct fs_file_t fp;
    fs_file_t_init(&fp);
    int ret = vfs_open(&fp, path, FS_O_READ);
    if (ret < 0) {
        snprintf(response, sizeof(response), "+READFILE: open failed (%d)", ret);
        QAT_Response_Str(QAT_RC_ERROR, response);
        return QAT_STATUS_SUCCESS_E;
    }

    uint8_t chunk[FSTORE_READ_CHUNK_SIZE];
    int32_t nread;
    while ((nread = vfs_read(&fp, chunk, sizeof(chunk))) > 0) {
        QAT_Response_Buffer(QAT_RC_QUIET, (char *)chunk, (uint32_t)nread);
    }

    vfs_close(&fp);

    if (nread < 0) {
        snprintf(response, sizeof(response), "+READFILE: read error (%d)", (int)nread);
        QAT_Response_Str(QAT_RC_ERROR, response);
    } else {
        QAT_Response_Str(QAT_RC_OK, NULL);
    }

    return QAT_STATUS_SUCCESS_E;
}

/*-------------------------------------------------------------------------
 * AT+DELFILE=<path>
 *-----------------------------------------------------------------------*/
static QAT_Command_Status_t Extend_Command_DelFile(uint32_t Op_Type, uint32_t Parameter_Count,
                                                   QAT_Parameter_t *Parameter_List)
{
    char response[64];

    if (Op_Type != QAT_OP_EXEC_W_PARAM) {
        QAT_Response_Str(QAT_RC_OK, "+DELFILE=<path>");
        return QAT_STATUS_SUCCESS_E;
    }

    if (Parameter_Count < 1 || !Parameter_List[0].String_Value) {
        QAT_Response_Str(QAT_RC_ERROR, "+DELFILE: usage AT+DELFILE=<path>");
        return QAT_STATUS_SUCCESS_E;
    }

    if (!is_fs_mounted()) {
        QAT_Response_Str(QAT_RC_ERROR, "+DELFILE: filesystem not mounted");
        return QAT_STATUS_SUCCESS_E;
    }

    char path[FSTORE_MAX_PATH];
    if (normalize_path(Parameter_List[0].String_Value, path, sizeof(path)) < 0) {
        QAT_Response_Str(QAT_RC_ERROR, "+DELFILE: path too long");
        return QAT_STATUS_SUCCESS_E;
    }

    int ret = vfs_unlink(path);
    if (ret < 0) {
        snprintf(response, sizeof(response), "+DELFILE: failed (%d)", ret);
        QAT_Response_Str(QAT_RC_ERROR, response);
    } else {
        QAT_Response_Str(QAT_RC_OK, NULL);
    }

    return QAT_STATUS_SUCCESS_E;
}

/*-------------------------------------------------------------------------
 * Public: Initialize_QAT_Fstore_Demo
 *-----------------------------------------------------------------------*/
void Initialize_QAT_Fstore_Demo(void)
{
    memset(&writefile_state, 0, sizeof(writefile_state));
    QAT_Register_Command_Group(QAT_Fstore_Command_List,
        sizeof(QAT_Fstore_Command_List) / sizeof(QAT_Command_t));
}
```

## src/qat_http_server_demo.c
```c
/*
 * Copyright (c) 2024 Qualcomm Innovation Center, Inc. All rights reserved.
 * SPDX-License-Identifier: BSD-3-Clause-Clear
 */

/*-------------------------------------------------------------------------
 * Include Files
 *-----------------------------------------------------------------------*/
#include <stdio.h>
#include <stdarg.h>
#include "string.h"
#include "qapi_version.h"
#include "qapi_rtc.h"
#include "qapi_heap_status.h"
#include "qat.h"
#include "qat_api.h"
#include "qurt_internal.h"
#include "nt_osal.h"
#include "nt_socpm_sleep.h"
#include "qurt_mutex.h"
#include "wifi_fw_version.h"
#include "wifi_fw_pmu_ts_cfg.h"
#include "dns.h"
#include "ip_addr.h"
#include "at_web_server.h"

#define WEBSERVER_STR_BUFFER_LENGTH 64
/*-------------------------------------------------------------------------
 * Function Declarations
 *-----------------------------------------------------------------------*/

static QAT_Command_Status_t Extend_Command_WEBSERVER(uint32_t Op_Type, uint32_t Parameter_Count,
                                                     QAT_Parameter_t *Parameter_List);

static QAT_Command_Status_t Extend_Command_Cmd(uint32_t Op_Type, uint32_t Parameter_Count,
                                               QAT_Parameter_t *Parameter_List);

static uint32_t mem_test = 123;

/* The following is the complete command list for the QAT common command demo. */
/** List of global commands that are supported when in a group. */
static QAT_Command_t QAT_Http_Server_Command_List[] = {
    {"+WEBSERVER", Extend_Command_WEBSERVER, QAT_OP_EXEC | QAT_OP_EXEC_W_PARAM},
};
/*-------------------------------------------------------------------------
 * External parameters
 *-----------------------------------------------------------------------*/
extern HTC_Context_t HTC_Context;

/*-------------------------------------------------------------------------
 * Parameters define
 *-----------------------------------------------------------------------*/

#define HTTP_SERVER_COMMAND_LIST_SIZE (sizeof(QAT_Http_Server_Command_List) / sizeof(QAT_Command_t))

#define CMD_STR_BUFFER_LENGTH         1024
#define NORMAL_RESPONSE_BUFFER_LENGTH 1024

QAT_Command_Status_t Extend_Command_WEBSERVER(uint32_t Op_Type, uint32_t Parameter_Count,
                                              QAT_Parameter_t *Parameter_List)
{
    char *buffer = NULL;
    QAT_Command_Status_t rc = QAT_STATUS_ERROR_E;
    uint8_t enable = 0;
    uint32_t port = 80;
    int ret = 0;

    switch (Op_Type) {
        case QAT_OP_EXEC: /* AT+WEBSERVER */
        {
            buffer = malloc(WEBSERVER_STR_BUFFER_LENGTH);

            if (!buffer) {
                QAT_Response_Str(QAT_RC_ERROR, NULL);
                return rc;
            }

            memset(buffer, 0, WEBSERVER_STR_BUFFER_LENGTH);
            snprintf(buffer, WEBSERVER_STR_BUFFER_LENGTH, "+WEBSERVER: <enable>,<server_port>\r\n");
            rc = QAT_Response_Str(QAT_RC_OK, buffer);
            memset((void *)buffer, 0, WEBSERVER_STR_BUFFER_LENGTH);
            free(buffer);
            buffer = NULL;
            break;
        }
        case QAT_OP_EXEC_W_PARAM: /* AT+WEBSERVER */
        {
            if (!Parameter_List || (Parameter_Count > 2) ||
                (Parameter_Count == 1 && !Parameter_List[0].Integer_Is_Valid) ||
                (Parameter_Count == 1 && (Parameter_List[0].Integer_Value == 1)) ||
                (Parameter_Count == 2 &&
                 (!Parameter_List[0].Integer_Is_Valid || !Parameter_List[1].Integer_Is_Valid))) {
                rc = QAT_Response_Str(QAT_RC_ERROR, "+WEBSERVER:Wrong Input, AT+WEBSERVER? for hint\r\n");
                return rc;
            }

            enable = Parameter_List[0].Integer_Value;
            port = Parameter_List[1].Integer_Value;
            if (enable) {
                ret = at_web_start(port);
            } else {
                ret = at_web_stop();
            }

            if (ret == 0) {
                rc = QAT_Response_Str(QAT_RC_OK, NULL);
            } else {
                rc = QAT_Response_Str(QAT_RC_ERROR, NULL);
            }

            break;
        }
        default:;
    }

    return rc;
}

void Initialize_QAT_Http_Server_Demo(void)
{
    qbool_t RetVal;
    RetVal = QAT_Register_Command_Group(QAT_Http_Server_Command_List, HTTP_SERVER_COMMAND_LIST_SIZE);
    if (RetVal == false) {
        printf("Failed to register common command group.\n");
    }
}
```

## src/qat_httpc_demo.h
```c
/*
 * Copyright (c) 2024 Qualcomm Innovation Center, Inc. All rights reserved.
 * SPDX-License-Identifier: BSD-3-Clause-Clear
 */

/*-------------------------------------------------------------------------
 * Include Files
 *-----------------------------------------------------------------------*/
#include <stdio.h>
#include <stdarg.h>
#include "string.h"

/*-------------------------------------------------------------------------
 * Parameters define
 *-----------------------------------------------------------------------*/
#define HTTPC_COMMAND_LIST_SIZE                (sizeof(QAT_HTTPC_Command_List) / sizeof(QAT_Command_t))
#define QAT_ATCMD_BUF_LEN                      1400
#define VERSION_STR_BUFFER_LENGTH              256
#define INFO_STR_BUFFER_LENGTH                 256
#define HTTP_STR_BUFFER_LENGTH                 256
#define CMD_STR_BUFFER_LENGTH                  1024
#define TIMEOUT_MS                             10000    // 10s
#define MAX_TIMEOUT_MS                         1800000  // 1800s
#define QAT_HTTPC_MAXIMUM_NUMBER_OF_PARAMETERS 15
#define QAT_HTTPC_MAXIMUM_NUMBER_OF_KEY_VALUE  (QAT_HTTPC_MAXIMUM_NUMBER_OF_PARAMETERS - 2)
#define QAT_HTTPC_CLIENT_INDEX                 1
#define HTTP_HOST_STR_BUFFER_LENGTH            128
#define HTTP_BODY_BUFFER_SIZE                  10000
#define HTTP_WAIT_RSP_TIME                     100  // 100*100(HTTP_WAIT_RSP_CYCLE_INTERVAL) = 10000ms =10s
#define HTTP_WAIT_RSP_CYCLE_INTERVAL           100  // ms
#define FILE_PATH_STR_BUFFER_LENGTH            32
#define HTTP_URL_STR_BUFFER_LENGTH             256
#define HTTPS_DEFAULT_PORT                     443
#define HTTP_DEFAULT_PORT                      80
#define HTTPC_DEFAULT_IP_PREFER                0  // 0:ipv4, 1:ipv6
#define HTTPC_DEFAULT_CACHE_DATA               QAT_CACHE_DATA
#define HTTPC_DEFAULT_KEEP_ALIVE               QAT_NOT_KEEP_ALIVE
//#define HTTPC_NOT_CACHE_DATA_THRESHOLD                10//2000
#define QAT_HTTPC_MAX_HEADER_FIELD 10
#define QAT_MAX_CHUNK_SIZE         1000
#define QAT_CHUNK_INTERVAL         10  // ms
#define QAT_HTTP_HEADER_NAME_LEN   32
#define QAT_HTTP_HEADER_VALUE_LEN  128
#define QATHTTPC_PRINTF(...)       printf(__VA_ARGS__)

struct at_header_field {
    char *name;
    char *value;
};

struct at_https_global_config {
#define AT_HTTPS_NOT_AUTH    0
#define AT_HTTPS_SERVER_AUTH 1
#define AT_HTTPS_CLIENT_AUTH 2
#define AT_HTTPS_BOTH_AUTH   3
    uint8_t https_auth_type;
    char ca_file[FILE_PATH_STR_BUFFER_LENGTH];
    char cert_file[FILE_PATH_STR_BUFFER_LENGTH];
    char key_file[FILE_PATH_STR_BUFFER_LENGTH];

    uint32_t http_port;
    uint32_t https_port;
    uint8_t httpc_ip_prefer;
    uint8_t is_pre_buffer;
    uint8_t is_cache_data;
    uint32_t url_size;
    char *url;
    uint8_t is_keep_alive;

    // temporary resource for one at cmd opertaion
    char *temp_url;
    char *send_buff;  // len <= HTTP_BODY_BUFFER_SIZE
    uint32_t buff_offset;
    uint32_t data_len;
    uint8_t header_field_num;
    struct at_header_field header_field[QAT_HTTPC_MAX_HEADER_FIELD];
};

typedef enum { QAT_HTTP = 1, QAT_HTTPS } qat_HTTP_type;

typedef enum {
    /*supported http client methods */
    QAT_HEAD_CONTENT_TYPE,
    QAT_HEAD_ACCEPT,
    QAT_HEAD_CACHE_CONTROL,
    QAT_HEAD_USER_AGENT,
    QAT_HEAD_AUTHORIZATION,
    QAT_HEAD_MAX
} qat_head_type;

typedef enum {
    /*supported http client methods */
    QAT_HTTP_CLIENT_HEAD = 1,
    QAT_HTTP_CLIENT_GET,
    QAT_HTTP_CLIENT_POST,
    QAT_HTTP_CLIENT_PUT
} qat_HTTPc_Method;

typedef enum {
    /*supported http client methods */
    QAT_CONTENT_TYPE_X_WWW_FORM_URLENCODED,  // application/x-www-form-urlencoded, default value
    QAT_CONTENT_TYPE_JSON,                   // application/json
    QAT_CONTENT_TYPE_ZIP,                    // application/zip
    QAT_CONTENT_TYPE_FORM_DATA,              // multipart/form-data
    QAT_CONTENT_TYPE_TEXT_XML                // text/xml
} qat_content_type;

typedef enum {
    QAT_NET_CFG_HTTP_PORT,
    QAT_NET_CFG_HTTPS_PORT,
    QAT_NET_CFG_IP_PREFER,
    QAT_NET_CFG_PRE_ACCLOCATE_SSL_BUFFER,
    QAT_NET_CFG_CACHE_DATA,
    QAT_NET_CFG_SESSION_KEEP_ALIVE,
    QAT_NET_CFG_MAX
} net_cfg_type;

typedef enum { IP_V4, IP_V6 } ip_type;

typedef enum {
    QAT_SSL_PRE_BUFFER_INITIAL,
    QAT_SSL_PRE_BUFFER_ALLOCATE,
    QAT_SSL_PRE_BUFFER_RELEASE
} qat_pre_buffer_type;

typedef enum { QAT_NOT_CACHE_DATA, QAT_CACHE_DATA } cache_data_type;

typedef enum { QAT_NOT_KEEP_ALIVE, QAT_KEEP_ALIVE } keep_alive_type;

/*-------------------------------------------------------------------------
 * Function Declarations
 *-----------------------------------------------------------------------*/
static int at_arg_is_string(const char *arg);
static int at_arg_is_null(const char *arg);
int at_arg_get_number(const char *arg, int *value);
int at_arg_get_hexstr_number(const char *arg, uint32_t *value);
int at_arg_get_string(const char *arg, char *string, int max);
qapi_Status_t at_httpc_disconn(int32_t client_num);
qapi_Status_t at_httpc_stop();
qapi_Status_t at_httpc_conn(char *url);
qapi_Status_t at_httpc_new_session(char *url, int32_t timeout);
qapi_Status_t at_httpc_start();
qapi_Status_t at_httpc_request(int32_t opt, char *url, char *data_buf);
qapi_Status_t at_httpc_getsize(char *url, int32_t timeout);
qapi_Status_t at_httpc_get(char *url, int32_t timeout);
qapi_Status_t at_httpc_post(char *url, int32_t data_len, char *data);
qapi_Status_t at_httpc_post2(char *url, int32_t data_len, char *data, int32_t numb, qbool_t finish);
qapi_Status_t at_httpc_put(char *url, int32_t data_len, char *data);
qapi_Status_t at_httpc_put2(char *url, int32_t data_len, char *data, int32_t numb, qbool_t finish);
uint32_t splitKeyValuePairs(char *input, QAPI_Console_Parameter_t *Parameter_List);
void gethostURL(const char *url, char *hostURL);
qbool_t getpathURL(const char *url, char *pathURL);
void parseURL(const char *url, char *protocol, char *domain, char *path);
qapi_Status_t at_httpc_setbodydata(char *data_buf, uint32_t len);
qapi_Status_t at_httpc_addheaderfield(/*uint8_t headfield_type,*/ uint8_t content_type);
qbool_t saveUrl(const char *url);
qbool_t saveheaderfield(const char *headerfield);
void resetSslInfo();
qbool_t isSecureSession(const char *url);
qbool_t create_send_buffer(int length);
void savedata(const char *data);
void reset_resource();
void reset_temp_resource();
qbool_t save_content_type(uint8_t content_type);
qbool_t is_succ_resp_code(int errorcode);
int validate_url(const char *url);
int get_valid_data_len(const char *data);

static QAT_Command_Status_t Extend_Command_HttpClient(uint32_t Op_Type, uint32_t Parameter_Count,
                                                      QAT_Parameter_t *Parameter_List);
static QAT_Command_Status_t Extend_Command_HttpGetSize(uint32_t Op_Type, uint32_t Parameter_Count,
                                                       QAT_Parameter_t *Parameter_List);
static QAT_Command_Status_t Extend_Command_HttpGet(uint32_t Op_Type, uint32_t Parameter_Count,
                                                   QAT_Parameter_t *Parameter_List);
static QAT_Command_Status_t Extend_Command_HttpPost(uint32_t Op_Type, uint32_t Parameter_Count,
                                                    QAT_Parameter_t *Parameter_List);
static QAT_Command_Status_t Extend_Command_HttpPut(uint32_t Op_Type, uint32_t Parameter_Count,
                                                   QAT_Parameter_t *Parameter_List);
static QAT_Command_Status_t Extend_Command_HttpUrlCfg(uint32_t Op_Type, uint32_t Parameter_Count,
                                                      QAT_Parameter_t *Parameter_List);
static QAT_Command_Status_t Extend_Command_HttpSslCfg(uint32_t Op_Type, uint32_t Parameter_Count,
                                                      QAT_Parameter_t *Parameter_List);
static QAT_Command_Status_t Extend_Command_HttpNetCfg(uint32_t Op_Type, uint32_t Parameter_Count,
                                                      QAT_Parameter_t *Parameter_List);

/* The following is the complete command list for the QAT common command demo. */
/** List of global commands that are supported when in a group. */
/*
AT+HTTPCLIENT:   send HTTP client request
AT+HTTPGETSIZE:  get HTTP resource size
AT+HTTPGET:      get HTTP resource
AT+HTTPPOST:     Post HTTP data
AT+HTTPPUT:      put HTTP data
AT+HTTPURLCFG:   set/get long HTTP URL
AT+HTTPSSLCFG:   set/get HTTP certificate
*/
static QAT_Command_t QAT_HTTPC_Command_List[] = {
    {"+HTTPCLIENT", Extend_Command_HttpClient, QAT_OP_EXEC | QAT_OP_EXEC_W_PARAM},
    {"+HTTPGETSIZE", Extend_Command_HttpGetSize, QAT_OP_EXEC | QAT_OP_QUERY | QAT_OP_EXEC_W_PARAM},
    {"+HTTPGET", Extend_Command_HttpGet, QAT_OP_EXEC | QAT_OP_QUERY | QAT_OP_EXEC_W_PARAM},
    {"+HTTPPOST", Extend_Command_HttpPost, QAT_OP_EXEC | QAT_OP_EXEC_W_PARAM},
    {"+HTTPPUT", Extend_Command_HttpPut, QAT_OP_EXEC | QAT_OP_EXEC_W_PARAM},
    {"+HTTPURLCFG", Extend_Command_HttpUrlCfg, QAT_OP_EXEC | QAT_OP_EXEC_W_PARAM | QAT_OP_QUERY},
    {"+HTTPSSLCFG", Extend_Command_HttpSslCfg, QAT_OP_EXEC | QAT_OP_EXEC_W_PARAM | QAT_OP_QUERY},
    {"+HTTPNETCFG", Extend_Command_HttpNetCfg, QAT_OP_EXEC | QAT_OP_EXEC_W_PARAM | QAT_OP_QUERY},
};

#define AT_CMD_PARSE_OPT_STRING(i, string, max, valid)                                \
    do {                                                                              \
        if (Parameter_Count > i && !at_arg_is_null(Parameter_List[i].String_Value)) { \
            if (!at_arg_get_string(Parameter_List[i].String_Value, string, max)) {    \
                return QAT_RC_ERROR;                                                  \
            }                                                                         \
            valid = 1;                                                                \
        }                                                                             \
    } while (0);

#define AT_CMD_PARSE_NUMBER(i, num)                                     \
    do {                                                                \
        if (!at_arg_get_number(Parameter_List[i].Integer_Value, num)) { \
            return QAT_RC_ERROR;                                        \
        }                                                               \
    } while (0);
```

## src/qat_tcpip_demo.h
```c
/*
 * Copyright (c) 2024 Qualcomm Innovation Center, Inc. All rights reserved.
 * SPDX-License-Identifier: BSD-3-Clause-Clear
 */

/*-------------------------------------------------------------------------
 * Include Files
 *-----------------------------------------------------------------------*/
#include "icmp.h"
#include "icmp6.h"
#include "sockets.h"
#include "queue.h"
#include "autoconf.h"

#ifndef QAT_MAX_MTU_PACKET_SIZE
#define QAT_MAX_MTU_PACKET_SIZE         1370
#endif	

#ifndef QAT_CIRCULAR_BUFFER_SIZE
#define QAT_CIRCULAR_BUFFER_SIZE        (QAT_MAX_MTU_PACKET_SIZE * CONFIG_QAT_CB_SIZE_MTU_MULTIPLIER)
#endif			    

#if LWIP_IPV4 && LWIP_IPV6
typedef struct icmp6_echo_hdr icmp6_echo_hdr;
typedef struct icmp_echo_hdr icmp4_echo_hdr;

typedef struct icmp_echo {
	union {
		icmp6_echo_hdr icmp_6;
		icmp4_echo_hdr icmp_4;
  } u_icmp;
}icmpm_echo_hdr;

/** @ingroup icmp6
 * Convert generic icmp to specific protocol version
 */
#define icmpm_2_icmp(ipaddr)   (&((ipaddr)->u_icmp.icmp_4))
#define icmpm_2_icmp6(ipaddr)   (&((ipaddr)->u_icmp.icmp_6))

#else /* LWIP_IPV4 && LWIP_IPV6 */

#if LWIP_IPV4
typedef struct icmp_echo_hdr icmpm_echo_hdr;
#define icmpm_2_icmp(ipaddr)						(ipaddr)
#define icmpm_2_icmp6(ipaddr)						(ipaddr)
#else /* LWIP_IPV4 */

typedef struct icmp6_echo_hdr icmpm_echo_hdr;
#define icmpm_2_icmp(ipaddr)						(ipaddr)
#define icmpm_2_icmp6(ipaddr)						(ipaddr)
#endif /* LWIP_IPV4 */
#endif /* LWIP_IPV4 && LWIP_IPV6 */


typedef enum {
	PROTOCOL_INVALID,
	PROTOCOL_TCP,
	PROTOCOL_TCPv6,
	PROTOCOL_UDP,
	PROTOCOL_UDPv6,
	PROTOCOL_SSL,
	PROTOCOL_SSLv6
} Protocol;

typedef enum {
	INACTIVE,
	ACTIVE
} qat_connect_status;

typedef enum{
	DHCP_TURN_ON = 0,
	DHCP_TURN_OFF= 1
} dhcp_action;

typedef enum {
    RECVTYPE_ACTIVE,
    RECVTYPE_PASSIVE
} receiveType_mode;

typedef struct {
    char buffer[QAT_CIRCULAR_BUFFER_SIZE];
    size_t head;
	size_t tail;
	size_t size;
	qurt_mutex_t mutex;
} CircularBuffer;

typedef struct {
	int id;
	int len;
} QueueElem;

typedef struct {
	int id;
	int sockfd;
	int protocol_type;
	int active;
	int recv_type;
	bool thread_quit;
	struct sockaddr_in addr;
	struct sockaddr_in6 addr6;
	CircularBuffer *cb;
} client_ctx_t;

union server_params {
    int port;
    int closeServer;
};

typedef struct {
	int mode;
	union server_params params;
} server_config;

typedef union {
    struct sockaddr_in v4_addr;
    struct sockaddr_in6 v6_addr;
} sock_addr;

typedef struct {
	int sockfd;
	bool active;
	int recv_type;
} server_ctx_t;

typedef struct {
	int sockfd;
	sock_addr addr;
	bool active;
	bool v6;
	int recv_type;
} udp_server_ctx_t;
```
