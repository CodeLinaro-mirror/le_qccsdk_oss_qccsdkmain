## Kconfig
```kconfig
mainmenu "Fermion Kconfig"

source "boards/Kconfig"
source "soc/Kconfig"

source "lib/Kconfig"
source "modules/console/Kconfig"
source "modules/fw_upgrade/Kconfig"

source "../comp/wifi/core/Kconfig"
```

## boards/mqm405i/Kconfig.board
```kconfig
config BOARD_MQM405I
	bool "BOARD Ehong MQM405I as QCC730V2 MP board on iPA"
	select SOC_QCC730V2
	default n
```

## boards/mqm405x/Kconfig.board
```kconfig
config BOARD_MQM405X
	bool "BOARD Ehong MQM405X as QCC730V2 MP board on xPA"
	select SOC_QCC730V2
	default n
```

## boards/mqm730i/Kconfig.board
```kconfig
config BOARD_MQM730I
	bool "BOARD Ehong MQM730I as QCC730V2 MP board on iPA"
	select SOC_QCC730V2
	default n
```

## boards/mqm730x/Kconfig.board
```kconfig
config BOARD_MQM730X
	bool "BOARD Ehong MQM730X as QCC730V2 MP board on xPA"
	select SOC_QCC730V2
	default n
```

## lib/Kconfig
```kconfig
menu "lib setting"
config FREERTOS_PLUS_POSIX
    bool "enable FreeRTOS-Plus-POSIX"
    default n

config QCCSDK_DEMO
    bool "enable QCCSDK DEMO"
    default n
config FLASH_SHELL
    bool "enable flash shell"
    depends on BOARD_QCC730_QSPI_ENABLE
    default n
config WIFI_SHELL
    bool "enable wifi shell"
    default n
config WLAN_QAPI
    bool "enable WLAN QAPI"
    default n
config PLATFORM_SHELL
    bool "enable platform shell"
    default n
config LOWPOWER_SHELL
    bool "enable low power shell"
    default n
config I2CM_SHELL
    bool "enable i2c master shell"
    default n
config GPIO_SHELL
    bool "enable gpio shell"
    default n
config NET_SHELL
    bool "enable net shell"
    default n
config PROF
    bool "enable PROF"
    default n
config PLATFORM_QAPI
    bool "enable platform qapi"
    default y
config QTIMER
    bool "enable QTIMER"
    default n

config HEAP_STATISTIC
    bool "enable heap statistic"
    default n
config WMI_EVENT
    bool "enable wmi event"
    default y
config RING_IF
    bool "enable ring interface"
    default n
config SAP_POWERSAVE
    bool "enable powersave for sap"
    default n
config WFM_EN
    bool "enable WFM"
    default y
config DEBUG_STATS
    bool "enable DEBUG_STATS"
    default n
config DPM_STATS
    bool "enable DPM_STATS"
    default n
config RA_DEBUG
    bool "enable RA_DEBUG"
    default n
config WPS
    bool "enable WPS"
    default n
config P2P
    bool "enable P2P"
    default n
config COEX_MCI
    bool "enable COEX_MCI"
    default n
config COEX_PTA
    bool "enable COEX_PTA"
    default n
config 6G_BAND
    bool "enable 6G_BAND"
    default y
config LWIP_HEAP_POOL
    bool "enable LWIP_HEAP_POOL"
    default n

config FTM_MODE
    bool "enable FTM mode"
    default n

config DEBUG_CMD_XPA
    depends on BOARD_QCC730_XPA_AUTO_CTRL_ENABLE
    bool "config debug cmd xpa"
    default y

config CH12_CH13_DISABLE_XPA
    depends on BOARD_QCC730_XPA_AUTO_CTRL_ENABLE
    bool "config channel 12 13 to disable xpa"
    default n
    
config SIGMA_TRAFFIC
    bool "enable SIGMA_TRAFFIC"
    default y

config UNITTEST_SHELL
    bool "enable unit_test commands"
    default n
    
endmenu
```

## modules/Kconfig
```kconfig
source "./modules/console/Kconfig"
source "./modules/fw_upgrade/Kconfig"
source "./modules/core/system/inc/Kconfig"
source "./modules/core/system/sys_src/Kconfig"
source "./modules/core/system/Kconfig"
source "./modules/fs/Kconfig"
source "./modules/net/mqtt_client/Kconfig"
source "./modules/wifi/Kconfig"
```

## modules/core/system/sys_src/Kconfig
```kconfig
menu "System Setting"

config PBL_PREES_GPIO_RESTORE
	bool "Restore GPIO to reset state, so to fix pre-ES PBL wrong operation on GPIO. If ioe_PBL released, please default to n"
	default y

config PBL_PREES_RESET_FOR_DTIM
	bool "A reset with CFG_FORCE_NPS_PD_ON is needed for Sleep function. If ioe_PBL released, please default to n"
	default n

config RING_IF_ONLY
        bool "Enable RingIF for hosted mode. if hostless mode, please default to n"
        default n

config QCSPI_HFC_TEST 
        bool "Enable QCSPI Slave HFC test demo. if QCSPI HFC test demo is not needed , please default to n"
        default n

config QCSPI_HFC_ETH_ENABLE 
        bool "Enable QCSPI Slave HFC Viertual Ethernet interface. if QCSPI HFC ETH is not needed , please default to n"
        default n

config WATCH_DOG_ENABLE
	bool "Watch Dog function. Please default to n"
	default n

config WATCH_DOG_BARK_TIME
	int "When this timer timeout, it will trigger the bark interrupt, in unit of seconds. Make sure to be smaller than bite timer."
	depends on WATCH_DOG_ENABLE
	default 4

config WATCH_DOG_BITE_TIME
	int "When this timer timeout, it will trigger the reset, in unit of seconds.  Make sure to be bigger than bark timer."
	depends on WATCH_DOG_ENABLE
	default 5

config CPR_ENABLE
	bool "Core Power Reduction support, please default to y"
	default y

config QTMR_GRAY_CODING_WAR
	bool "A workaround to fix QTMR clock offset, please default to y"
	default y

config ULP_SMPS2_ONTSHOT_OPTIMIZE
	bool "Optimize ULP SMPS2 ontshot to support high temperature and low battery"
	default y

config PMU_TS_MON_PERIOD_US
	int "Temperature and VBAT are monitored interlavedly with this peroid us"
	default 1000000

config PRINTF_ERR
	bool "enalbe printf error message by err_printf"
	default y

config PRINTF_WARN
	bool "enalbe printf warning message by warn_printf"
	default y

config PRINTF_INFO
	bool "enalbe printf info message by info_printf"
	default y

config PRINTF_LOG
	bool "enalbe printf log message by log_printf"
	default n

config PRINTF_DUMP
	bool "enalbe printf dump message by dump_printf"
	default n

config ERROR_PREFIX
	string "prefix for err_printf"
	default "[ERR]"

config WARN_PREFIX
	string "prefix for warn_printf"
	default "[WARN]"

config INFO_PREFIX
	string "prefix for info_printf"
	default "[INFO]"

config LOG_PREFIX
	string "prefix for log_printf"
	default "[LOG]"

config DUMP_PREFIX
	string "prefix for dump_printf"
	default "[DUMP]"

rsource "mpu.Kconfig"

endmenu
```

## modules/net/mbedtls/Kconfig
```kconfig
menu "mbedTLS setting"
config MBEDTLS_USE_PKA
    bool "enable PKA for MbedTLS"
    default y

config MBEDTLS_PKA_TEST
    bool "enable test for Mbedtls PKA"
    depends on MBEDTLS_USE_PKA
    default y
endmenu
```

## modules/qat/Kconfig
```kconfig
menu "qat setting"
config QAT
    bool "enable QAT"
    default n
config QAT_COMMON_DEMO
    bool "enable QAT COMMON DEMO"
    default n
config QAT_TRANSMISSION_MODULE
    int "change transmission module for QAT. 0:UART, 1:SPI"
    default 0
config QAT_TCPIP_DEMO
    bool "enable QAT TCPIP DEMO"
    default n
endmenu
```

## modules/wifi/Kconfig
```kconfig
menu "WiFi setting"
rsource "Kconfig.rtt"
rsource "Kconfig.wapp"
rsource "Kconfig.lib"

menu "System Setting"
config PBL_PREES_GPIO_RESTORE
	bool "Restore GPIO to reset state, so to fix pre-ES PBL wrong operation on GPIO. If ioe_PBL released, please default to n"
	default y

config PBL_PREES_RESET_FOR_DTIM
	bool "A reset with CFG_FORCE_NPS_PD_ON is needed for Sleep function. If ioe_PBL released, please default to n"
	default n

config RING_IF_ONLY
        bool "Enable RingIF for hosted mode. if hostless mode, please default to n"
        default n

config QCSPI_HFC_TEST 
        bool "Enable QCSPI Slave HFC test demo. if QCSPI HFC test demo is not needed , please default to n"
        default n

config WATCH_DOG_ENABLE
	bool "Watch Dog function. Please default to n"
	default n

config WATCH_DOG_BARK_TIME
	int "When this timer timeout, it will trigger the bark interrupt, in unit of seconds. Make sure to be smaller than bite timer."
	depends on WATCH_DOG_ENABLE
	default 4

config WATCH_DOG_BITE_TIME
	int "When this timer timeout, it will trigger the reset, in unit of seconds.  Make sure to be bigger than bark timer."
	depends on WATCH_DOG_ENABLE
	default 5

config CPR_ENABLE
	bool "Core Power Reduction support, please default to n"
	default n

rsource "mpu.Kconfig"

endmenu
endmenu
```

## modules/wifi/Kconfig.lib
```kconfig
menu "wifi lib setting"

config WIFILIB_6GHZ
    bool "enable 6G support in wifi lib"
    default y

config MGMT_FILTER_DEMO 
    bool "enable management frames filter DEMO"
    default n

config ACK_TIMEOUT_MODIFY_ENABLE
    bool "enable set ack timeout"
    default y

config QOS_NULL_DATA_MAX_RETRY_COUNT
    hex "set qos null data max retry count"
    default 20 if ACK_TIMEOUT_MODIFY_ENABLE = n
    default 10 if ACK_TIMEOUT_MODIFY_ENABLE = y

config QOS_NULL_DATA_RETRY_DELAY
    hex "set qos null data retry delay"
    default 100 if ACK_TIMEOUT_MODIFY_ENABLE = n
    default 100 if ACK_TIMEOUT_MODIFY_ENABLE = y

config HEAVY_CLIP_ENABLE
    bool "enable heavy_clip adjust"
    default n

config HEAVY_CLIP_LEVEL_2G
    int "select heavy_clip level in 2g"
    depends on HEAVY_CLIP_ENABLE
    range 0 2
    default 0

config HEAVY_CLIP_LEVEL_5G
    int "select heavy_clip level in 5g"
    depends on HEAVY_CLIP_ENABLE
    range 0 2
    default 0

config PEAKW_11N_0_2G
    hex "peak windowing clip thresolds for 11n packets in 2g"
    depends on HEAVY_CLIP_ENABLE
    default 0x5D47473C if HEAVY_CLIP_LEVEL_2G = 0
    default 0x64584E2E if HEAVY_CLIP_LEVEL_2G = 1
    default 0xFFFFFFFF if HEAVY_CLIP_LEVEL_2G = 2

config PEAKW_11A_0_2G
    hex "peak windowing clip thresolds for 11a packets in 2g"
    depends on HEAVY_CLIP_ENABLE
    default 0x564E4739 if HEAVY_CLIP_LEVEL_2G = 0
    default 0x64584E2E if HEAVY_CLIP_LEVEL_2G = 1
    default 0xFFFFFFFF if HEAVY_CLIP_LEVEL_2G = 2

config PEAKW_11A_1_2G
    hex "peak windowing clip thresolds for 11a packets in 2g"
    depends on HEAVY_CLIP_ENABLE
    default 0x5D if HEAVY_CLIP_LEVEL_2G = 0
    default 0x64 if HEAVY_CLIP_LEVEL_2G = 1
    default 0xFF if HEAVY_CLIP_LEVEL_2G = 2

config PEAKW_11N_0_5G
    hex "peak windowing clip thresolds for 11n packets in 5g"
    depends on HEAVY_CLIP_ENABLE
    default 0x62514D3F if HEAVY_CLIP_LEVEL_5G = 0
    default 0x62514D3F if HEAVY_CLIP_LEVEL_5G = 1
    default 0xFFFFFFFF if HEAVY_CLIP_LEVEL_5G = 2

config PEAKW_11A_0_5G
    hex "peak windowing clip thresolds for 11a packets in 5g"
    depends on HEAVY_CLIP_ENABLE
    default 0x60523F3F if HEAVY_CLIP_LEVEL_5G = 0
    default 0x60523F3F if HEAVY_CLIP_LEVEL_5G = 1
    default 0xFFFFFFFF if HEAVY_CLIP_LEVEL_5G = 2

config PEAKW_11A_1_5G
    hex "peak windowing clip thresolds for 11a packets in 5g"
    depends on HEAVY_CLIP_ENABLE
    default 0x62 if HEAVY_CLIP_LEVEL_5G = 0
    default 0x62 if HEAVY_CLIP_LEVEL_5G = 1
    default 0xFF if HEAVY_CLIP_LEVEL_5G = 2

config SRRC_BAND_EDGE_SUPPORT
    bool "enable band edge adjust for ch12 and ch13"
    default y

config ENABLE_P2P_MODE
    bool "enable p2p support"
    default n

config ENABLE_P2P_LIB
    bool "enable p2p lib support"
    default n

            endmenu
```
